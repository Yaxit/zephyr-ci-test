## prj.conf
```kconfig
# nothing here

CONFIG_CONSOLE=y
CONFIG_STDOUT_CONSOLE=y
```

## src/main.c
```c
/*
 * Copyright (c) 2012-2014 Wind River Systems, Inc.
 *
 * SPDX-License-Identifier: Apache-2.0
 */

#include <stdio.h>
#include <zephyr/kernel.h>
#include <zephyr/logging/log.h>

LOG_MODULE_REGISTER(main);

int main(void)
{
	LOG_INF("Started");
	while(1){
		printk("Hello World!\n");
		k_msleep(1000);
	}

	return 0;
}
```
